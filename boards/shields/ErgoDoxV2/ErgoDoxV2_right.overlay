#include "ergodox.dtsi" // Notice that the main dtsi files are included in the overlay.
&default_transform { // The matrix transform for this board is 7 columns over because the left half is 7 columns wide according to the matrix.
    col-offset = <8>;
};
&kscan0 {
    col-gpios //                                   pin
        = <&pro_micro 10 GPIO_ACTIVE_HIGH> // col0  017
        , <&pro_micro 16 GPIO_ACTIVE_HIGH> // col1  020
        , <&pro_micro 14 GPIO_ACTIVE_HIGH> // col2  022
        , <&pro_micro 15 GPIO_ACTIVE_HIGH> // col3  024
        , <&pro_micro 18 GPIO_ACTIVE_HIGH> // col4  100
        , <&pro_micro 19 GPIO_ACTIVE_HIGH> // col5  011
        , <&pro_micro 20 GPIO_ACTIVE_HIGH> // col6  104
        , <&pro_micro 21 GPIO_ACTIVE_HIGH> // col7  106
        ;
};
