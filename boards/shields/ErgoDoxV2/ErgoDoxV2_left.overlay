#include "ErgoDoxV2.dtsi" // Notice that the main dtsi files are included in the overlay.

&kscan0 {
    col-gpios //                                   pin
        = <&pro_micro 10 GPIO_ACTIVE_HIGH> // col0  017
        , <&pro_micro 16 GPIO_ACTIVE_HIGH> // col1  020
        , <&pro_micro 14 GPIO_ACTIVE_HIGH> // col2  022
        , <&pro_micro 15 GPIO_ACTIVE_HIGH> // col3  024
        , <&pro_micro 18 GPIO_ACTIVE_HIGH> // col4  104
        , <&pro_micro 19 GPIO_ACTIVE_HIGH> // col5  104
        , <&pro_micro 20 GPIO_ACTIVE_HIGH> // col6  104
        , <&pro_micro 21 GPIO_ACTIVE_HIGH> // col7  104
        ;
};