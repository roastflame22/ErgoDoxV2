## boards/shields/ErgoDoxV2/Kconfig.defconfig
```kconfig
if SHIELD_ERGODOXV2_LEFT

config ZMK_KEYBOARD_NAME
    default "ErgoDoxV2"

config ZMK_SPLIT_ROLE_CENTRAL
    default y

endif

if SHIELD_ERGODOXV2_LEFT || SHIELD_ERGODOXV2_RIGHT

config ZMK_SPLIT
    default y

endif
```

## boards/shields/ErgoDoxV2/Kconfig.shield
```kconfig
config SHIELD_ERGODOXV2_LEFT
    def_bool $(shields_list_contains,ErgoDoxV2_left)

config SHIELD_ERGODOXV2_RIGHT
    def_bool $(shields_list_contains,ErgoDoxV2_right)
```
